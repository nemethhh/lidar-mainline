## donut-linux/Documentation/devicetree/bindings/extcon/mediatek,mt8167-accdet.yaml
```yaml
# SPDX-License-Identifier: (GPL-2.0-only OR BSD-2-Clause)
%YAML 1.2
---
$id: http://devicetree.org/schemas/extcon/mediatek,mt8167-accdet.yaml#
$schema: http://devicetree/meta-schemas/core.yaml#

title: MediaTek MT8167/MT8516 headset jack detection (ACCDET, Amazon variant)

maintainers:
  - LeagueRaINi <19365835+LeagueRaINi@users.noreply.github.com>

description: |
  Headphone jack insertion detection of the Amazon Echo Dot (3rd
  generation) family: a GPIO of the pin controller (EINT0) reads the
  mechanical switch of the 3.5 mm jack, level triggered with the
  polarity flipped by the driver on every event.  The state is
  reported through the extcon class (EXTCON_JACK_HEADPHONE).  This
  variant has no register interface; the ACCDET register block of the
  SoC (0x1001b000) is unused by it.

properties:
  compatible:
    const: mediatek,mt8167-accdet

  interrupts:
    maxItems: 1
    description: the jack GPIO as a level triggered interrupt of the pin
      controller; the polarity in the device tree is the plug-in level.

  accdet-gpios:
    maxItems: 1
    description: the GPIO reading the jack state; active while a plug is
      inserted (the vendor device trees expressed an active-high reading
      plus an "invert" flag, which the polarity flag here replaces).

  optical-gpios:
    maxItems: 1
    description: optional GPIO reading the optical-cable detect of a
      TOSLINK adapter; when it reads active during insertion, the
      insertion is not reported as a headphone.

  eint-debounce:
    $ref: /schemas/types.yaml#/definitions/uint32
    description: debounce of the jack GPIO while waiting for insertion,
      in microseconds.

  accdet-plugout-debounce:
    $ref: /schemas/types.yaml#/definitions/uint32
    description: debounce of the jack GPIO while waiting for removal, in
      microseconds.

  mute-amplifier:
    type: boolean
    description: request a fast mute of the speaker amplifier on jack
      removal (the vendor hook into the audio subsystem is not ported
      yet; the driver warns when this is set).

  pinctrl-0: true
  pinctrl-1: true

  pinctrl-names:
    oneOf:
      - items:
          - const: state_eint_as_int
      - items:
          - const: default
          - const: state_eint_as_int

required:
  - compatible
  - interrupts
  - accdet-gpios
  - eint-debounce
  - accdet-plugout-debounce

additionalProperties: false

examples:
  - |
    #include <dt-bindings/gpio/gpio.h>
    #include <dt-bindings/interrupt-controller/irq.h>

    accdet {
        compatible = "mediatek,mt8167-accdet";
        interrupt-parent = <&pio>;
        interrupts = <0 IRQ_TYPE_LEVEL_LOW>;
        accdet-gpios = <&pio 0 GPIO_ACTIVE_LOW>;
        eint-debounce = <512000>;
        accdet-plugout-debounce = <20000>;
        pinctrl-names = "state_eint_as_int";
        pinctrl-0 = <&accdet_pins_eint_as_int>;
    };

...
```

## donut-linux/Documentation/devicetree/bindings/sound/amazon,donut-sound.yaml
```yaml
# SPDX-License-Identifier: (GPL-2.0-only OR BSD-2-Clause)
%YAML 1.2
---
$id: http://devicetree.org/schemas/sound/amazon,donut-sound.yaml#
$schema: http://devicetree.org/meta-schemas/core.yaml#

title: Amazon Echo Dot (3rd generation) sound card

maintainers:
  - LeagueRaAINi <19365835+LeagueRaINi@users.noreply.github.com>

description:
  Sound card of the MediaTek MT8516 based Amazon Echo Dot (3rd
  generation), codename "donut".  A TAS2770 smart amplifier on the I2S
  output of the SoC drives the speaker.  Four microphones are digitized
  by two stereo ADCs, which share the data line of the TDM input of the
  SoC, and the playback is looped back for echo reference.  The
  headphone jack on the integrated codec of the SoC is an optional
  link of the card.

properties:
  compatible:
    const: amazon,donut-sound

  mediatek,platform:
    $ref: /schemas/types.yaml#/definitions/phandle
    description: The phandle of the MT8516 audio front end.

  speaker-dai-link:
    type: object
    description: Container for the codec of the playback DAI link.

    properties:
      codec:
        type: object

        properties:
          sound-dai:
            maxItems: 1
            description: phandle of the smart amplifier.

        required:
          - sound-dai

        additionalProperties: false

    required:
      - codec

    additionalProperties: false

  mic-dai-link:
    type: object
    description: Container for the codecs of the microphone DAI link.

    properties:
      codec:
        type: object

        properties:
          sound-dai:
            minItems: 1
            maxItems: 2
            description:
              phandles of the microphone ADCs in the order of their slot
              pairs in the TDM frame.

        required:
          - sound-dai

        additionalProperties: false

    required:
      - codec

    additionalProperties: false

  jack-dai-link:
    type: object
    description: |
      Container for the codec of the headphone jack DAI link ("HP", the
      integrated codec of the SoC).  Optional; without it the card has
      no jack link and the DL1 front end only serves the speaker.

    properties:
      codec:
        type: object

        properties:
          sound-dai:
            maxItems: 1
            description: phandle of the integrated codec.

        required:
          - sound-dai

        additionalProperties: false

    required:
      - codec

    additionalProperties: false

required:
  - compatible
  - mediatek,platform
  - speaker-dai-link
  - mic-dai-link

additionalProperties: false

examples:
  - |
    sound {
        compatible = "amazon,donut-sound";
        mediatek,platform = <&afe>;

        speaker-dai-link {
            codec {
                sound-dai = <&spk_amp>;
            };
        };

        mic-dai-link {
            codec {
                sound-dai = <&adc0>, <&adc1>;
            };
        };

        jack-dai-link {
            codec {
                sound-dai = <&mt8167_codec>;
            };
        };
    };

...
```

## donut-linux/Documentation/devicetree/bindings/sound/mediatek,mt8167-codec.yaml
```yaml
# SPDX-License-Identifier: (GPL-2.0-only OR BSD-2-Clause)
%YAML 1.2
---
$id: http://devicetree.org/schemas/sound/mediatek,mt8167-codec.yaml#
$schema: http://devicetree/meta-schemas/core.yaml#

title: MediaTek MT8167/MT8516 integrated audio codec

maintainers:
  - LeagueRaINi <19365835+LeagueRaINi@users.noreply.github.com>

description: |
  The integrated audio codec of the MediaTek MT8167/MT8516 SoC: the
  analog headphone and line outputs, the analog and digital microphone
  inputs and the DC-offset compensation of the headphone drivers.  It
  has no register block of its own; its registers are the analog
  baseband block of the audio front end (AFE offsets 0x0f00..0x0f4c)
  and the AUDIO_CODEC block of the apmixedsys (offsets 0x0700..0x0710),
  reached through phandles.

properties:
  compatible:
    const: mediatek,mt8167-codec

  "#sound-dai-cells":
    const: 0

  clocks:
    maxItems: 1
    description: the audio bus clock (topckgen CLK_TOP_AUDIO).

  clock-names:
    const: bus

  mediatek,afe-regmap:
    $ref: /schemas/types.yaml#/definitions/phandle
    description: phandle of the audio front end holding the ABB registers.

  mediatek,apmixedsys-regmap:
    $ref: /schemas/types.yaml#/definitions/phandle
    description: phandle of the apmixedsys syscon holding the codec control
      block.

  mediatek,dmic-wire-mode:
    $ref: /schemas/types.yaml#/definitions/uint32
    enum: [0, 1]
    description: |
      wiring of the digital microphone inputs:
      0 - one wire (both channels on one pin)
      1 - two wire (one pin per channel)

  mediatek,dmic-ch-phase:
    $ref: /schemas/types.yaml#/definitions/uint32-array
    minItems: 2
    maxItems: 2
    items:
      maximum: 7
    description: latch phase (in clock cycles, 0-7) of the left and right
      digital microphone channels.

  mediatek,dmic-rate-mode:
    $ref: /schemas/types.yaml#/definitions/uint32
    enum: [0, 1]
    description: |
      clock rate of the digital microphone inputs:
      0 - 1.625 MHz
      1 - 3.25 MHz

  mediatek,headphone-cap-sel:
    $ref: /schemas/types.yaml#/definitions/uint32
    enum: [0, 1, 2, 3]
    description: |
      capacitor at the headphone outputs, selecting the depop charge
      current of the VCM generator:
      0 - up to 10 uF
      1 - up to 22 uF
      2 - up to 33 uF
      3 - up to 47 uF

required:
  - compatible
  - "#sound-dai-cells"
  - clocks
  - clock-names
  - mediatek,afe-regmap
  - mediatek,apmixedsys-regmap

additionalProperties: false

examples:
  - |
    #include <dt-bindings/clock/mt8516-clk.h>

    audio-codec {
        compatible = "mediatek,mt8167-codec";
        #sound-dai-cells = <0>;
        clocks = <&topckgen CLK_TOP_AUDIO>;
        clock-names = "bus";
        mediatek,afe-regmap = <&afe>;
        mediatek,apmixedsys-regmap = <&apmixedsys>;
        mediatek,dmic-wire-mode = <1>;
        mediatek,headphone-cap-sel = <1>;
    };

...
```

## lidar-linux/Documentation/devicetree/bindings/iio/light/ams,tsl2540.yaml
```yaml
# SPDX-License-Identifier: (GPL-2.0-only OR BSD-2-Clause)
%YAML 1.2
---
$id: http://devicetree.org/schemas/iio/light/ams,tsl2540.yaml#
$schema: http://devicetree.org/meta-schemas/core.yaml#

title: ams TSL2540 Ambient Light Sensor

maintainers:
  - LeagueRaINi <19365835+LeagueRaINi@users.noreply.github.com>

description: |
  Light-to-digital converter with a photopic visible channel and an IR
  channel on an I2C interface.

  Datasheet:
    https://look.ams-osram.com/m/d83ec5eb2896cf6/original/TSL2540-DS000564.pdf

properties:
  compatible:
    const: ams,tsl2540

  reg:
    maxItems: 1

  interrupts:
    maxItems: 1

  vdd-supply: true

required:
  - compatible
  - reg

additionalProperties: false

examples:
  - |
    #include <dt-bindings/interrupt-controller/irq.h>

    i2c {
        #address-cells = <1>;
        #size-cells = <0>;

        light-sensor@39 {
            compatible = "ams,tsl2540";
            reg = <0x39>;
            interrupt-parent = <&gpio>;
            interrupts = <12 IRQ_TYPE_LEVEL_LOW>;
            vdd-supply = <&vdd_1v8>;
        };
    };
...
```

## lidar-linux/Documentation/devicetree/bindings/sound/amazon,lidar-sound.yaml
```yaml
# SPDX-License-Identifier: (GPL-2.0-only OR BSD-2-Clause)
%YAML 1.2
---
$id: http://devicetree.org/schemas/sound/amazon,lidar-sound.yaml#
$schema: http://devicetree.org/meta-schemas/core.yaml#

title: Amazon Echo Plus (2nd generation) sound card

maintainers:
  - LeagueRaINi <19365835+LeagueRaINi@users.noreply.github.com>

description:
  Sound card of the MediaTek MT8516 based Amazon Echo Plus (2nd generation),
  codename "lidar". A DAC on the I2S output of the SoC drives either the
  speaker amplifier or the line output through an analog switch. The
  microphone array is digitized by stereo ADCs, which share the data line of
  the TDM input of the SoC.

properties:
  compatible:
    const: amazon,lidar-sound

  mediatek,platform:
    $ref: /schemas/types.yaml#/definitions/phandle
    description: The phandle of the MT8516 audio front end.

  amp-enable-gpios:
    maxItems: 1
    description: GPIO enabling the speaker amplifier.

  dac-mux-gpios:
    maxItems: 1
    description:
      GPIO controlling the analog switch at the output of the DAC. The active
      level routes the DAC to the speaker amplifier, the inactive level to the
      line output.

  speaker-dai-link:
    type: object
    description: Container for the codec of the playback DAI link.

    properties:
      codec:
        type: object

        properties:
          sound-dai:
            maxItems: 1
            description: phandle of the DAC.

        required:
          - sound-dai

        additionalProperties: false

    required:
      - codec

    additionalProperties: false

  mic-dai-link:
    type: object
    description: Container for the codecs of the microphone DAI link.

    properties:
      codec:
        type: object

        properties:
          sound-dai:
            minItems: 1
            maxItems: 4
            description:
              phandles of the microphone ADCs in the order of their slot
              pairs in the TDM frame.

        required:
          - sound-dai

        additionalProperties: false

    required:
      - codec

    additionalProperties: false

required:
  - compatible
  - mediatek,platform
  - amp-enable-gpios
  - dac-mux-gpios
  - speaker-dai-link
  - mic-dai-link

additionalProperties: false

examples:
  - |
    #include <dt-bindings/gpio/gpio.h>

    sound {
        compatible = "amazon,lidar-sound";
        mediatek,platform = <&afe>;
        amp-enable-gpios = <&pio 105 GPIO_ACTIVE_HIGH>;
        dac-mux-gpios = <&pio 109 GPIO_ACTIVE_HIGH>;

        speaker-dai-link {
            codec {
                sound-dai = <&dac>;
            };
        };

        mic-dai-link {
            codec {
                sound-dai = <&adc0>, <&adc1>, <&adc2>, <&adc3>;
            };
        };
    };

...
```
